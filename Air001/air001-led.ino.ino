#pragma GCC optimize ("O0")
// 855 
char font[ 95 ][ 9 ]={ 0 ,  256 ,  256 ,  0 ,  0 ,  256 ,  256 ,  0 ,  0 ,     //[ ]
 0 ,  0 ,  262 ,  351 ,  351 ,  262 ,  0 ,  0 ,  0 ,     //[!]
 0 ,  0 ,  7 ,  7 ,  256 ,  263 ,  263 ,  256 ,  0 ,     //["]
 0 ,  276 ,  383 ,  383 ,  20 ,  127 ,  383 ,  276 ,  0 ,     //[#]
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 0 ,  2 ,  3 ,  1 ,  3 ,  2 ,  3 ,  1 ,  0 ,     //[~]
};
#define EVENT PB_1
#define P0 PB_2
#define P1 PB_0
#define P2 PA_7
#define P3 PA_4
#define P4 PA_3
#define P5 PA_2
#define P6 PA_1
#define P7 PA_0
const int DISP[8]={P7,P6,P5,P4,P3,P2,P1,P0}; 

void setup() {
  // put your setup code here, to run once:
 for(int i=0;i<8;i++)
      pinMode(DISP[i], OUTPUT);
 // Serial.begin(115200);
 // Serial.printf("Hello, Air001. \n");
  pinMode(EVENT, INPUT);
}
int mydelay(int n){
  int s=0; 
  for(int k=0;k<n;k++)s+=k;
  return s;
}
void disp(char * data){
  for(int j=0;j<9;j++){
    for(int i=0;i<8;i++){
      if(data[j] & (1<<i)){
        digitalWrite(DISP[i], HIGH);
      }else{
        digitalWrite(DISP[i], LOW);
      }
      mydelay(30);
    }
  }
}
void dispB(char * data){
  for(int j=8;j>=0;j--){
    for(int i=0;i<8;i++){
      if(data[j] & (1<<i)){
        digitalWrite(DISP[i], HIGH);
      }else{
        digitalWrite(DISP[i], LOW);
      }
      mydelay(30);
    }
//     Serial.printf("%d ", j);
  }
//   Serial.printf("done\n");
}
void display(char * msg){
      //digitalWrite(PB_1, HIGH);
    int i=0;
    for(i=0;msg[i]>0;i++){
      char c=msg[i];
     // Serial.printf("%c\n", c);
      char f=c - ' ';
      disp(font[f]);
      delay(1);
    }
}
void displayB(char * msg){
  //  Serial.printf("len:%d\n",i); 
  int i=strlen(msg);
    for(i--;i>=0;i--){
      char c=msg[i];
     // Serial.printf("%c\n", c);
      char f=c - ' ';
      dispB(font[f]);
      delay(1);
    //   Serial.printf("ok:%d\n",i); 
    }
}
char old=digitalRead(EVENT);
void waitEVENT(char state){
  
  while(state==digitalRead(EVENT)){
  }
}
void loop() {
  // put your main code here, to run repeatedly:
  static int count = 0;
  const int total=9;
  const int rep=12;
  char msg[total][64]={"  666    ",
                       "  Love   ",
                       "  Linux  ",
                       "  YYDS   ",
                       "  Hello! ",
                       "  2023   ",
                       "  China  ",
                       "  2024   ",
                       "  ^_^    "};
  //sprintf(msg,"%d", count);
 // old=digitalRead(EVENT);
  waitEVENT(LOW);
      display(msg[(count/rep) % total]);
  waitEVENT(HIGH);
      displayB(msg[(count/rep) % total]);
  count++;
}
